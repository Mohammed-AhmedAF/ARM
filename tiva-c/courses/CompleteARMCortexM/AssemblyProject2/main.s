		AREA |.text|,CODE,READONLY,ALIGN=2
		THUMB
		EXPORT Main
	
SYSCTL_RCGCGPIO_R EQU 0x400FE608
GPIO_PORTF_DIR_R EQU 0x40025400
GPIO_PORTF_DEN_R EQU 0x4002551C
GPIO_PORTF_DATA_R EQU 0x400253FC
GPIO_PORTF_PUR_R EQU 0x40025510
GPIO_PORTF_LOCK_R EQU 0x40025520
GPIO_PORTF_CR_R EQU 0x40025524
GPIO_LOCK_KEY EQU 0x4C4F434B
	
PIN_LED_RED EQU 0x02
PIN_LED_BLUE EQU 0x04
PIN_LED_GREEN EQU 0x08
	
SEC_DIV_FIVE EQU 1066666

Main
	BL GPIO_Init
	B loop

GPIO_Init
	LDR R1,=SYSCTL_RCGCGPIO_R
	MOV R0,#0x20
	STR R0,[R1]; STR from Source to Destination
	
	LDR R1,=GPIO_PORTF_LOCK_R
	LDR R0,=GPIO_LOCK_KEY
	STR R0,[R1] 
	
	LDR R1,=GPIO_PORTF_CR_R
	MOV R0,#0xFF
	STR R0,[R1]
	
	LDR R1,=GPIO_PORTF_DIR_R
	MOV R0,#0x02
	STR R0,[R1]
	
	LDR R1,=GPIO_PORTF_PUR_R
	MOV R0,#0x10
	STR R0,[R1]
	
	LDR R1,=GPIO_PORTF_DEN_R
	MOV R0,#0x13
	STR R0,[R1]
	
	BX LR
	
delay 
	SUBS R0,R0,#1
	BNE delay ;Go back to delay if status register doesn't have the zero flag raised
	BX LR

processInput
	LDR R1,=GPIO_PORTF_DATA_R ;Only pointing to the register
	LDR R0,[R1]
	AND R0,R0,#0x11
	BX LR

loop
	LDR R0,=SEC_DIV_FIVE
	BL delay
	BL processInput
	CMP R0,#0x10
	BEQ SWITCH_ON
		
Output
	LDR R1,=GPIO_PORTF_DATA_R
	STR R0,[R1]
	BX LR

SWITCH_ON
	MOV R0,#0x02
	LDR R1,=GPIO_PORTF_DATA_R
	STR R0,[R1]
	;BL Output
	B loop
	

	ALIGN
	END
	
	
